#include "P3.h"

int dosang;

extern TIM_HandleTypeDef htim2;
extern unsigned char loaiLED;

const uint16_t scan_PWM_duty[]={2,4,8,16,32,64,128,256,512,1028};   //he so chia nạp vao time pwm chan OE
unsigned int timer_clock[8]={18,36,72,144,288,575};                 // he so chia nap vao timer

unsigned int vitri_bit=0; // kiem tra xem dang quet den bit nao
unsigned int hang_led=0;
uint16_t Buffer_GPIO[SCAN_TYPE*MAX_BIT*64];
unsigned char Buffer_RGB[3*64*64]=
{
//Red 
0x56,0x55,0x51,0x4D,0x45,0x27,0x0A,0x01,0x01,0x01,0x02,0x03,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0x19,
0x5C,0x57,0x53,0x51,0x44,0x22,0x07,0x03,0x02,0x02,0x03,0x0A,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0x30,
0x63,0x5F,0x5D,0x57,0x44,0x21,0x08,0x03,0x03,0x03,0x02,0x0F,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0x37,
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0x85,0x89,0x83,0x7F,0x90,0x8A,0x87,0x8C,0x1C,0x02,0x16,0x63,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0x2B,
//Green 
0x51,0x4F,0x4B,0x4A,0x43,0x2B,0x10,0x06,0x05,0x05,0x05,0x07,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0x1E,
0x52,0x4E,0x4E,0x4D,0x3D,0x20,0x09,0x04,0x03,0x03,0x04,0x0A,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0x32,
0x55,0x4F,0x4E,0x4E,0x38,0x19,0x07,0x03,0x02,0x03,0x04,0x0F,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0x34,
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0x1B,0x25,0x26,0x28,0x37,0x39,0x38,0x3C,0x09,0x01,0x07,0x32,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0x08,
//Blue 
0x73,0x70,0x6E,0x70,0x70,0x6B,0x55,0x49,0x44,0x43,0x42,0x44,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0x1D,
0x73,0x6E,0x6E,0x6E,0x72,0x62,0x49,0x3D,0x38,0x37,0x3B,0x3D,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0x2A,
0x70,0x6B,0x6B,0x68,0x6B,0x57,0x42,0x2F,0x2D,0x31,0x37,0x3C,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0x29,
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0x02,0x02,0x02,0x02,0x02,0x02,0x02,0x02,0x00,0x00,0x00,0x02,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0x03,

};


//---------------------------------Chuong trinh quet LED ma tran --------------------------------------------------------//
const unsigned char scan_data[SCAN_TYPE]=
{
	  //0,8,4,12, 2,10,6,14, 1,9,5,13, 3,11,7,15,
	 0,8,4,12,20,16,24,28 ,2,10,6,14,22,18,26,30 ,1,9,5,13,21,17,25,29 ,3,11,7,15,23,19,27,31,
};

void scan32S(char so)
{
	switch(so)
	{
		case 0: Control_P->BSRR= E_RSET|D_RSET|C_RSET|B_RSET|A_RSET;  return;
		case 1: Control_P->BSRR= E_RSET|D_RSET|C_RSET|B_RSET|A_SSET; 	return;
		case 2: Control_P->BSRR= E_RSET|D_RSET|C_RSET|B_SSET|A_RSET;  return;
		case 3: Control_P->BSRR= E_RSET|D_RSET|C_RSET|B_SSET|A_SSET;  return;
		case 4: Control_P->BSRR= E_RSET|D_RSET|C_SSET|B_RSET|A_RSET;  return;
		case 5: Control_P->BSRR= E_RSET|D_RSET|C_SSET|B_RSET|A_SSET;  return;
		case 6: Control_P->BSRR= E_RSET|D_RSET|C_SSET|B_SSET|A_RSET; 	return;
		case 7: Control_P->BSRR= E_RSET|D_RSET|C_SSET|B_SSET|A_SSET;  return;
		case 8: Control_P->BSRR= E_RSET|D_SSET|C_RSET|B_RSET|A_RSET;  return;
		case 9: Control_P->BSRR= E_RSET|D_SSET|C_RSET|B_RSET|A_SSET;  return;
		case 10:Control_P->BSRR= E_RSET|D_SSET|C_RSET|B_SSET|A_RSET;  return;
		case 11:Control_P->BSRR= E_RSET|D_SSET|C_RSET|B_SSET|A_SSET;  return;
		case 12:Control_P->BSRR= E_RSET|D_SSET|C_SSET|B_RSET|A_RSET;  return;
		case 13:Control_P->BSRR= E_RSET|D_SSET|C_SSET|B_RSET|A_SSET;  return;
		case 14:Control_P->BSRR= E_RSET|D_SSET|C_SSET|B_SSET|A_RSET;  return;
		case 15:Control_P->BSRR= E_RSET|D_SSET|C_SSET|B_SSET|A_SSET;  return;
		case 16: Control_P->BSRR= E_SSET|D_RSET|C_RSET|B_RSET|A_RSET;  return;
		case 17: Control_P->BSRR= E_SSET|D_RSET|C_RSET|B_RSET|A_SSET;  return;
		case 18: Control_P->BSRR= E_SSET|D_RSET|C_RSET|B_SSET|A_RSET;  return;
		case 19: Control_P->BSRR= E_SSET|D_RSET|C_RSET|B_SSET|A_SSET;  return;
		case 20: Control_P->BSRR= E_SSET|D_RSET|C_SSET|B_RSET|A_RSET;  return;
		case 21: Control_P->BSRR= E_SSET|D_RSET|C_SSET|B_RSET|A_SSET;  return;
		case 22: Control_P->BSRR= E_SSET|D_RSET|C_SSET|B_SSET|A_RSET;  return;
		case 23: Control_P->BSRR= E_SSET|D_RSET|C_SSET|B_SSET|A_SSET;  return;
		case 24: Control_P->BSRR= E_SSET|D_SSET|C_RSET|B_RSET|A_RSET;  return;
		case 25: Control_P->BSRR= E_SSET|D_SSET|C_RSET|B_RSET|A_SSET;  return;
		case 26:Control_P->BSRR= E_SSET|D_SSET|C_RSET|B_SSET|A_RSET;  return;
		case 27:Control_P->BSRR= E_SSET|D_SSET|C_RSET|B_SSET|A_SSET;  return;
		case 28:Control_P->BSRR= E_SSET|D_SSET|C_SSET|B_RSET|A_RSET;  return;
		case 29:Control_P->BSRR= E_SSET|D_SSET|C_SSET|B_RSET|A_SSET;  return;
		case 30:Control_P->BSRR= E_SSET|D_SSET|C_SSET|B_SSET|A_RSET;  return;
		case 31:Control_P->BSRR= E_SSET|D_SSET|C_SSET|B_SSET|A_SSET;  return;
	}
	//OE_P->BSRR = (1<<(OE+16));
}


void display(void)
{  
	  for(int hang=0;hang<SCAN_TYPE;hang++)
	  {
			uint16_t dat;
			for(int ts=0;ts<MAX_BIT;ts++)
			{
			 for(int i=0;i<64;i++)
			 {
				 dat = 0;
				 if((Buffer_RGB[1*arrD1 + (32+hang)*arrD2 + i] & (1<<ts)) != 0 ){dat|=(0x01<<G2);} //ghi bit 7 G2 
				 if((Buffer_RGB[1*arrD1 + (0+hang)*arrD2 + i]  & (1<<ts)) != 0 ){dat|=(0x01<<G1);} //ghi bit 0 G1
				 if((Buffer_RGB[0*arrD1 + (0+hang)*arrD2 + i]  & (1<<ts)) != 0 ){dat|=(0x01<<R1);} //ghi bit 1 R1
				 if((Buffer_RGB[2*arrD1 + (0+hang)*arrD2 + i]  & (1<<ts)) != 0 ){dat|=(0x01<<B1);} //ghi bit 4 B1
				 if((Buffer_RGB[0*arrD1 + (32+hang)*arrD2 + i] & (1<<ts)) != 0 ){dat|=(0x01<<R2);} //ghi bit 6 R2
				 if((Buffer_RGB[2*arrD1 + (32+hang)*arrD2 + i] & (1<<ts)) != 0 ){dat|=(0x01<<B2);} //ghi bit 9 B2
				 Buffer_GPIO[hang*MAX_BIT*64 + ts*64 + i]=dat;
			 }
			} 
		}
}
void ngatquetled(void)
{
  __HAL_TIM_SET_COMPARE(&htim2,TIM_CHANNEL_4,0);
	
  for(int i=0;i<64;i++)
	{
		data_PORT->ODR=Buffer_GPIO[scan_data[hang_led]*MAX_BIT*64 +vitri_bit*64 + i];
		clk_P->BSRR=(1<<clk);
		clk_P->BSRR=(1<<(clk+16));
	}	 	
		
	
	__HAL_TIM_SET_COMPARE(&htim2,TIM_CHANNEL_4,scan_PWM_duty[vitri_bit]);
	scan32S(scan_data[hang_led]);
	
	Control_P->BSRR=(1<<(LAT+16));
		Control_P->BSRR=(1<<LAT); // chot data
	

	vitri_bit++;
	if(vitri_bit==MAX_BIT){vitri_bit=0;hang_led++;if(hang_led==SCAN_TYPE)hang_led=0;}	
}
void SET_dosang(uint16_t sang)
{
	 dosang=sang;
}
uint16_t GET_dosang(void)
{
	 return dosang;
}

